
/********************include******************/
#include "delay.h"
#include "ioSTC8.h"
#include "type.h"
#include "hal_types.h"
/*********************************************/


/**************************************************************************************************
 *@函数            Delay_ms
 *
 *@简述            毫秒延时（24M内部RC振荡）
 *
 *@输入参数  
 *
 *@参数            ms - 1ms的倍数
 *
 *输出参数
 *
 *无
 * 
 *@返回     无
 **************************************************************************************************
 */
#pragma optimize=none  //防止IAR优化，避免延时不正常
void Delay_ms(uint16 ms)	
{
         uint8 i,j;
	for(uint16 num = 0; num < ms; num ++)
	{

		i = 16;
		j = 140;
		do
		{
			while (--j);
		} 
		while (--i);
	}
}
/**************************************************************************************************
 *@函数            名称：Delay5us_
 *
 *@简述            5微秒延时（24M内部RC振荡）
 *
 *@输入参数  
 *
 *@参数            us - 5us的倍数
 *
 *输出参数
 *
 *无
 * 
 *@返回     无
 **************************************************************************************************
 */
#pragma optimize=none  //防止IAR优化，避免延时不正常
void Delay5us(uint16 us)	
{
   volatile uint8  i;//加volatile，防止IAR优化，避免延时不正常
   for(uint16 num = 0; num < us; num++)
   {
		i = 20;
		while (--i);
   }
}

