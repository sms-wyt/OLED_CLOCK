#include "vs1053.h"
#include "ioSTC8.h"
#include "spi_hard.h"
#include "delay.h"
#include "ff.h"
#include "uart.h"
#include "heap_manage.h"


/**************************************引脚定义***************************************************/
#define   VS1053_XCS   P4_2    //VS1053片选输入（低电平有效）
#define   VS1053_DREQ  P2_7    //VS1053数据请求
#define   VS1053_REST  P4_0    //VS1053硬件复位（低电平有效）
#define   VS1053_XDCS  P2_6    //VS1053数据片选/字节同步
/**********************************VS1053相关寄存器************************************************/
#define   VS1053_MODE          0x00    //VS1053模式控制
#define   VS1053_STATUS        0x01    //VS1053状态
#define   VS1053_BASS          0x02    //VS1053内置高低音增强器
#define   VS1053_CLOCKF        0x03    //VS1053时钟频率+倍频数
#define   VS1053_DECODE_TIME   0x04    //VS1053解码时间
#define   VS1053_AUDATA        0x05    //VS1053各种音频数据
#define   VS1053_WRAM          0x06    //VS1053 RAM写/读
#define   VS1053_WRAMADDR      0x07    //VS1053 RAM写/读的基址
#define   VS1053_HDAT0         0x08    //VS1053流头地址0
#define   VS1053_HDAT1         0x09    //VS1053流头地址1
#define   VS1053_AIADDR        0x0a    //VS1053用户代码起始地址
#define   VS1053_VOL           0x0b    //VS1053音量控制
#define   VS1053_AICTRL0       0x0c    //VS1053应用控制寄存器0
#define   VS1053_AICTRL1       0x0d    //VS1053应用控制寄存器0
#define   VS1053_AICTRL2       0x0e    //VS1053应用控制寄存器0
#define   VS1053_AICTRL3       0x0f    //VS1053应用控制寄存器0
/**************************************************************************************************
 *@函数            vs1053_init
 *
 *@简述            vs1053初始化
 *
 *@输入参数  
 *
 *@参数            无
 *
 *输出参数
 *
 *无
 * 
 *@返回           无
 **************************************************************************************************
 */
void vs1053_init(void)
{
  VS1053_XDCS = 1;//
  VS1053_XCS = 1;
  VS1053_REST = 1;
  VS1053_DREQ = 1;
  set_hard_spi_speed(0x03);
  vs1053_hard_reset();
  vs1053_soft_reset(); 
  vs1053_volume_ctrl(230);
  set_hard_spi_speed(0x00);
}
/**************************************************************************************************
 *@函数            vs1053_soft_reset
 *
 *@简述            vs1053软件复位
 *
 *@输入参数  
 *
 *@参数            无
 *
 *输出参数
 *
 *无
 * 
 *@返回           无
 **************************************************************************************************
 */
void vs1053_soft_reset(void)
{
  uint8 value[2];
  value[0] = 0x08;//新模式
  value[1] = 0x04;//软件复位
  vs1053_SCI(0x02, VS1053_MODE, value, 2);
  value[0] = 0x98;//3倍频率、1.5xADD
  value[1] = 0x00;
  vs1053_SCI(0x02, VS1053_CLOCKF, value, 2);
}
/**************************************************************************************************
 *@函数            vs1053_soft_reset
 *
 *@简述            vs1053硬件复位
 *
 *@输入参数  
 *
 *@参数            无
 *
 *输出参数
 *
 *无
 * 
 *@返回           无
 *
 *说明：硬件重启会导致音量设置复位，默认上电为最高音量
 **************************************************************************************************
 */
void vs1053_hard_reset(void)
{
  VS1053_REST = 0;//硬件复位
  Delay_ms(20);//延时20ms
  VS1053_XDCS = 1;//取消数据传输
  VS1053_XCS = 1;//取消数据传输
  VS1053_REST = 1;
  while(!VS1053_DREQ);//等待VS1053空闲态
}
/**************************************************************************************************
 *@函数            vs1053_sin_test
 *
 *@简述            vs1053 sin测试
 *
 *@输入参数  
 *
 *@参数            无
 *
 *输出参数
 *
 *无
 * 
 *@返回           无
 *
 *说明：sine测试时，连接耳机，可以听到2声沉闷的滴答
 **************************************************************************************************
 */
void vs1053_sine_test(void)
{
  uint8 value[8] = {0};
  //vs1053_hard_reset();//硬件复位
  value[0] = 0x08;//VS1002模式
  value[1] = 0x20;//允许SDI测试
  vs1053_SCI(0x02, VS1053_MODE, value, 2);
    vs1053_volume_ctrl(160);
  value[0] = 0x53;
  value[1] = 0xef;
  value[2] = 0x6e;
  value[3] = 0x24;
  vs1053_SDI(value, 8);
  Delay_ms(200);//延时100ms
  value[0] = 0x45;
  value[1] = 0x78;
  value[2] = 0x69;
  value[3] = 0x74;
  vs1053_SDI(value, 8);
  Delay_ms(200);//延时100ms
  value[0] = 0x53;
  value[1] = 0xef;
  value[2] = 0x6e;
  value[3] = 0x44;
  vs1053_SDI(value, 8);
  Delay_ms(200);//延时100ms
  value[0] = 0x45;
  value[1] = 0x78;
  value[2] = 0x69;
  value[3] = 0x74;
  vs1053_SDI(value, 8);
  Delay_ms(200);//延时100ms
}
/**************************************************************************************************
 *@函数            vs1053_SCI
 *
 *@简述            vs1053串行指令接口操作(读/写寄存器)
 *
 *@输入参数  
 *
 *@参数            instruction - 指令（2-写 3-读）
 *                 addr - 寄存器地址
 *                 *data - 数据指针
 *                 len - 数据个数
 *
 *输出参数
 *
 *无
 * 
 *@返回           无
 **************************************************************************************************
 */
static void vs1053_SCI(uint8 instruction, uint8 addr, uint8 *data, uint32 len)
{
  uint8 cmd[2];
  cmd[0] = instruction;//指令
  cmd[1] = addr;//寄存器地址
  while(!VS1053_DREQ);//检测等待VS1053空闲
  VS1053_XCS = 0;//使能从机片选
  hard_spi_transaction(cmd, 2, NULL, 0);//发送操作指令和地址
  if(!(instruction & 0x01))//如果是写操作
    hard_spi_transaction(data, len, NULL, 0);//写入数据
  else
    hard_spi_transaction(NULL, 0, data, len);//读取数据
  VS1053_XCS = 1;//失能从机片选
}
/**************************************************************************************************
 *@函数            vs1053_SDI
 *
 *@简述            vs1053串行数据接口
 *
 *@输入参数  
 *
 *@参数            *data - 数据指针
 *                 len - 数据个数
 *输出参数
 *
 *无
 * 
 *@返回           无
 **************************************************************************************************
 */
 void vs1053_SDI(uint8 *data, uint32 len)
{
  while(!VS1053_DREQ);//等待VS1053空闲态
  VS1053_XDCS = 0;//使能从机片选
  hard_spi_transaction(data, len, NULL, 0);
  VS1053_XDCS = 1;//不选中数据传输
}
/**************************************************************************************************
 *@函数            vs1053_volume_ctrl
 *
 *@简述            vs1053音量控制
 *
 *@输入参数  
 *
 *@参数            volume - 音量(最小 → 最大：0-254)
 *                 
 *输出参数
 *
 *无
 * 
 *@返回           无
 **************************************************************************************************
 */
void vs1053_volume_ctrl(uint8 volume)
{
  uint8 value[2];
  value[0] = 254 - volume ;//左声道音量
  value[1] = value[0];//右声道音量
  vs1053_SCI(0x02, VS1053_VOL, value, 2);
}
/**************************************************************************************************
 *@函数            vs1053_reset_decode_time
 *
 *@简述            vs1053重设解码时间
 *
 *@输入参数  
 *
 *@参数            无
 *                 
 *输出参数
 *
 *无
 * 
 *@返回           无
 **************************************************************************************************
 */
void vs1053_reset_decode_time(void)
{
  uint8 value[2] = {0};
  vs1053_SCI(0x02, VS1053_DECODE_TIME, value, 2);
  vs1053_SCI(0x02, VS1053_DECODE_TIME, value, 2);
}
/**************************************************************************************************
 *@函数            vs1053_get_decode_time
 *
 *@简述            vs1053获取解码时间
 *
 *@输入参数  
 *
 *@参数            *decode - 解码时间（单位：秒）
 *                 
 *输出参数
 *
 *无
 * 
 *@返回           无
 **************************************************************************************************
 */
void vs1053_get_decode_time(uint16 *decode)
{
  uint8 value[2];
  vs1053_SCI(0x03, VS1053_DECODE_TIME, value, 2);
  *decode = (uint16)value[0] << 8;
  *decode |= value[1];
}
/**************************************************************************************************
 *@函数            vs1053_load_music
 *
 *@简述            vs1053加载音乐
 *
 *@输入参数  
 *
 *@参数            
 *                 
 *输出参数
 *
 *无
 * 
 *@返回           无
 **************************************************************************************************
 */

void vs1053_load_music(uint8 *pname)
{
  uint8 value[2];
  value[0] = 0x08;//新模式
  value[1] = 0x02;//允许解码
  vs1053_SCI(0x02, VS1053_MODE, value, 2);
  value[0] = 0x7a;//
  value[1] = 0x00;//
  vs1053_SCI(0x02, VS1053_BASS, value, 2);
  
  uint8 res;
  uint16 rest;
  uint8 *data;//定义一个1024长度的数据缓存区
  FIL  *fmp3 ;
  uint16 brd;

  fmp3=(FIL*)heap_alloc(sizeof(FIL));//申请内存
  data = (uint8*)heap_alloc(1024);//申请1024字节内存
  
  res=f_open(fmp3,(const TCHAR*)pname, FA_READ);//打开文件

  while(1)
  {
    res=f_read(fmp3,data,1024,(UINT*)&brd);//读出1024个字节
   if(brd!=1024)
      {
        rest = brd/32*32;
	for(uint16 i = 0; i < rest; i += 32)//循环发送32次
          vs1053_SDI(data+i, 32);//发送32个字节数据
        vs1053_SDI(data+rest, brd%32);//发送剩下不足32个字节数据
	break;//读完了，跳出while循环	  
      } 
          for(uint16 i = 0; i < 1024; i += 32)//循环发送32次
        vs1053_SDI(data+i, 32);//发送32个字节数据

  }
   heap_free(fmp3);//释放内存
   heap_free(data);//释放内存
   fmp3 = NULL;//指向NULL
   data = NULL;//指向NULL
}

void vs1053_set_bass(void)
{
  uint8 value[2];
  value[0] = 0x7a;//
  value[1] = 0x00;//
  vs1053_SCI(0x02, VS1053_BASS, value, 2);
}